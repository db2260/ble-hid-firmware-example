## CMakeLists.txt
```
cmake_minimum_required(VERSION 3.20.0)

find_package(Zephyr REQUIRED HINTS $ENV{ZEPHYR_BASE})
project(prod_ble_hid_keyboard)

target_sources(app PRIVATE
  src/main.c
  src/ble_hid.c
  src/battery.c
  src/input_scanner.c
  src/factory_reset.c
  src/power.c
  src/app_watchdog.c
)
```

## prj.conf
```kconfig
CONFIG_BT=y
CONFIG_BT_PERIPHERAL=y
CONFIG_BT_DEVICE_NAME="ProdBLE Keyboard"
CONFIG_BT_DEVICE_APPEARANCE=961

CONFIG_BT_HIDS=y
CONFIG_BT_BAS=y
CONFIG_BT_DIS=y

CONFIG_BT_SMP=y
CONFIG_BT_SIGNING=y
CONFIG_BT_BONDABLE=y
CONFIG_BT_PRIVACY=y
CONFIG_BT_SETTINGS=y
CONFIG_SETTINGS=y
CONFIG_FLASH=y
CONFIG_FLASH_PAGE_LAYOUT=y
CONFIG_FLASH_MAP=y
CONFIG_NVS=y

CONFIG_GPIO=y
CONFIG_INPUT=y

CONFIG_PM=y
CONFIG_PM_DEVICE=y
CONFIG_WATCHDOG=y

CONFIG_BOOTLOADER_MCUBOOT=y
CONFIG_IMG_MANAGER=y
CONFIG_MCUMGR=y
CONFIG_MCUMGR_TRANSPORT_BT=y
CONFIG_MCUMGR_GRP_IMG=y
CONFIG_MCUMGR_GRP_OS=y
CONFIG_STREAM_FLASH=y

CONFIG_LOG=y
CONFIG_LOG_DEFAULT_LEVEL=3
```

## boards/nrf52840dk_nrf52840.overlay
```dts
&wdt {
    status = "okay";
};

/ {
    aliases {
        watchdog0 = &wdt;
    };
};
```

## src/main.c
```c
#include "battery.h"
#include "ble_hid.h"
#include "app_watchdog.h"
#include "factory_reset.h"
#include "input_scanner.h"
#include "power.h"

#include <errno.h>
#include <zephyr/kernel.h>
#include <zephyr/logging/log.h>
#include <zephyr/settings/settings.h>

#include <zephyr/bluetooth/bluetooth.h>
#include <zephyr/bluetooth/conn.h>
#include <zephyr/bluetooth/gatt.h>
#include <zephyr/bluetooth/hci.h>
#include <zephyr/bluetooth/uuid.h>
#include <zephyr/bluetooth/services/bas.h>
#include <zephyr/bluetooth/services/hids.h>

LOG_MODULE_REGISTER(app, LOG_LEVEL_INF);

static const struct bt_data ad[] = {
    BT_DATA_BYTES(BT_DATA_FLAGS, BT_LE_AD_GENERAL | BT_LE_AD_NO_BREDR),
    BT_DATA_BYTES(BT_DATA_UUID16_ALL,
        BT_UUID_16_ENCODE(BT_UUID_HIDS_VAL),
        BT_UUID_16_ENCODE(BT_UUID_BAS_VAL)),
};

static const struct bt_data sd[] = {
    BT_DATA(BT_DATA_NAME_COMPLETE, CONFIG_BT_DEVICE_NAME,
            sizeof(CONFIG_BT_DEVICE_NAME) - 1),
};

static void advertising_start(void)
{
    int err = bt_le_adv_start(
        BT_LE_ADV_CONN_FAST_1,
        ad, ARRAY_SIZE(ad),
        sd, ARRAY_SIZE(sd));

    if (err && err != -EALREADY) {
        LOG_ERR("Advertising failed: %d", err);
    } else {
        LOG_INF("Advertising");
    }
}

static void connected(struct bt_conn *conn, uint8_t err)
{
    if (err) {
        LOG_WRN("Connection failed: 0x%02x", err);
        advertising_start();
        return;
    }

    ble_hid_connected(conn);
    power_on_connected();
    LOG_INF("Connected");
}

static void disconnected(struct bt_conn *conn, uint8_t reason)
{
    ARG_UNUSED(conn);

    LOG_INF("Disconnected: 0x%02x", reason);
    ble_hid_disconnected();
    power_on_disconnected();
    advertising_start();
}

static bool le_param_req(struct bt_conn *conn, struct bt_le_conn_param *param)
{
    ARG_UNUSED(conn);

    param->interval_min = 6;
    param->interval_max = 12;
    param->latency = 30;
    param->timeout = 400;

    return true;
}

BT_CONN_CB_DEFINE(conn_callbacks) = {
    .connected = connected,
    .disconnected = disconnected,
    .le_param_req = le_param_req,
};

static void auth_cancel(struct bt_conn *conn)
{
    ARG_UNUSED(conn);
    LOG_WRN("Pairing cancelled");
}

static void pairing_complete(struct bt_conn *conn, bool bonded)
{
    ARG_UNUSED(conn);
    LOG_INF("Pairing complete, bonded=%d", bonded);
}

static void pairing_failed(struct bt_conn *conn, enum bt_security_err reason)
{
    ARG_UNUSED(conn);
    LOG_WRN("Pairing failed: %d", reason);
}

static struct bt_conn_auth_cb auth_cb = {
    .cancel = auth_cancel,
};

static struct bt_conn_auth_info_cb auth_info_cb = {
    .pairing_complete = pairing_complete,
    .pairing_failed = pairing_failed,
};

static void input_event_handler(uint8_t hid_keycode, bool pressed)
{
    int err = ble_hid_send_key_state(hid_keycode, pressed);

    if (err == -ENOTCONN) {
        LOG_DBG("Ignoring input while disconnected");
    } else if (err) {
        LOG_WRN("HID input send failed: %d", err);
    }
}

int main(void)
{
    int err;

    LOG_INF("Booting BLE HID keyboard");

    err = bt_enable(NULL);
    if (err) {
        LOG_ERR("Bluetooth init failed: %d", err);
        return 0;
    }

    if (IS_ENABLED(CONFIG_SETTINGS)) {
        settings_load();
    }

    err = factory_reset_check_boot_request();
    if (err) {
        LOG_WRN("Factory-reset check failed: %d", err);
    }

    bt_conn_auth_cb_register(&auth_cb);
    bt_conn_auth_info_cb_register(&auth_info_cb);

    err = ble_hid_init();
    if (err) {
        LOG_ERR("HID init failed: %d", err);
        return 0;
    }

    battery_service_init();
    power_init();

    err = input_scanner_init(input_event_handler);
    if (err) {
        LOG_ERR("Input scanner init failed: %d", err);
        return 0;
    }

    err = app_watchdog_init();
    if (err) {
        LOG_ERR("Watchdog init failed: %d", err);
        return 0;
    }

    advertising_start();

    while (true) {
        k_sleep(K_SECONDS(1));
        app_watchdog_feed();
        power_maintenance_run();
        battery_level_update();
    }
}
```

## src/app_watchdog.c
```c
#include "app_watchdog.h"

#include <zephyr/device.h>
#include <zephyr/devicetree.h>
#include <zephyr/drivers/watchdog.h>
#include <zephyr/logging/log.h>

LOG_MODULE_REGISTER(app_watchdog, LOG_LEVEL_INF);

#define WATCHDOG_TIMEOUT_MS 4000

#if DT_NODE_HAS_STATUS(DT_ALIAS(watchdog0), okay)
static const struct device *const wdt = DEVICE_DT_GET(DT_ALIAS(watchdog0));
#elif DT_HAS_COMPAT_STATUS_OKAY(nordic_nrf_wdt)
static const struct device *const wdt =
    DEVICE_DT_GET(DT_COMPAT_GET_ANY_STATUS_OKAY(nordic_nrf_wdt));
#else
static const struct device *const wdt;
#endif

static int channel_id = -1;

int app_watchdog_init(void)
{
    struct wdt_timeout_cfg cfg = {
        .window = {
            .min = 0,
            .max = WATCHDOG_TIMEOUT_MS,
        },
        .callback = NULL,
        .flags = WDT_FLAG_RESET_SOC,
    };
    int err;

    if (!wdt || !device_is_ready(wdt)) {
        LOG_WRN("No ready watchdog device; watchdog disabled");
        return 0;
    }

    channel_id = wdt_install_timeout(wdt, &cfg);
    if (channel_id < 0) {
        LOG_ERR("Watchdog timeout install failed: %d", channel_id);
        return channel_id;
    }

    err = wdt_setup(wdt, 0);
    if (err) {
        LOG_ERR("Watchdog setup failed: %d", err);
        return err;
    }

    LOG_INF("Watchdog enabled with %d ms timeout", WATCHDOG_TIMEOUT_MS);
    return 0;
}

void app_watchdog_feed(void)
{
    int err;

    if (!wdt || channel_id < 0) {
        return;
    }

    err = wdt_feed(wdt, channel_id);
    if (err) {
        LOG_WRN("Watchdog feed failed: %d", err);
    }
}
```

## src/app_watchdog.h
```c
#ifndef APP_WATCHDOG_H_
#define APP_WATCHDOG_H_

int app_watchdog_init(void);
void app_watchdog_feed(void);

#endif
```

## src/battery.c
```c
#include "battery.h"

#include <zephyr/bluetooth/services/bas.h>

static uint8_t battery_level = 100;

void battery_service_init(void)
{
    bt_bas_set_battery_level(battery_level);
}

uint8_t battery_level_get(void)
{
    return battery_level;
}

void battery_level_update(void)
{
    /*
     * Replace this placeholder with a calibrated ADC measurement and filtering.
     * Keep the value stable to avoid noisy BLE notifications.
     */
    bt_bas_set_battery_level(battery_level);
}
```

## src/battery.h
```c
#ifndef BATTERY_H_
#define BATTERY_H_

#include <stdint.h>

void battery_service_init(void);
uint8_t battery_level_get(void);
void battery_level_update(void);

#endif
```

## src/ble_hid.c
```c
#include "ble_hid.h"

#include <errno.h>
#include <zephyr/kernel.h>
#include <zephyr/logging/log.h>
#include <zephyr/bluetooth/services/hids.h>

LOG_MODULE_REGISTER(ble_hid, LOG_LEVEL_INF);

#define INPUT_REPORT_ID_KEYBOARD 1
#define OUTPUT_REPORT_ID_KEYBOARD 1

static struct bt_conn *current_conn;
static struct bt_hids hids;

static const uint8_t hid_report_map[] = {
    0x05, 0x01,       /* Usage Page Generic Desktop */
    0x09, 0x06,       /* Usage Keyboard */
    0xA1, 0x01,       /* Collection Application */

    0x85, INPUT_REPORT_ID_KEYBOARD,
    0x05, 0x07,       /* Usage Page Keyboard */
    0x19, 0xE0,
    0x29, 0xE7,
    0x15, 0x00,
    0x25, 0x01,
    0x75, 0x01,
    0x95, 0x08,
    0x81, 0x02,       /* Modifier byte */

    0x95, 0x01,
    0x75, 0x08,
    0x81, 0x01,       /* Reserved byte */

    0x95, 0x06,
    0x75, 0x08,
    0x15, 0x00,
    0x25, 0x65,
    0x05, 0x07,
    0x19, 0x00,
    0x29, 0x65,
    0x81, 0x00,       /* Key array */

    0x85, OUTPUT_REPORT_ID_KEYBOARD,
    0x95, 0x05,
    0x75, 0x01,
    0x05, 0x08,
    0x19, 0x01,
    0x29, 0x05,
    0x91, 0x02,       /* LED output report */

    0x95, 0x01,
    0x75, 0x03,
    0x91, 0x01,

    0xC0
};

static void keyboard_leds_written(struct bt_hids_rep *rep,
                                  struct bt_conn *conn,
                                  bool write)
{
    ARG_UNUSED(rep);
    ARG_UNUSED(conn);
    ARG_UNUSED(write);

    LOG_DBG("Keyboard LED state changed");
}

int ble_hid_init(void)
{
    static struct bt_hids_inp_rep input_reports[] = {
        {
            .id = INPUT_REPORT_ID_KEYBOARD,
            .size = 8,
        },
    };

    static struct bt_hids_outp_feat_rep output_reports[] = {
        {
            .id = OUTPUT_REPORT_ID_KEYBOARD,
            .size = 1,
            .handler = keyboard_leds_written,
        },
    };

    struct bt_hids_init_param init = {0};

    init.rep_map.data = hid_report_map;
    init.rep_map.size = sizeof(hid_report_map);
    init.info.bcd_hid = 0x0111;
    init.info.b_country_code = 0x00;
    init.info.flags = BT_HIDS_REMOTE_WAKE | BT_HIDS_NORMALLY_CONNECTABLE;
    init.is_kb = true;
    init.is_mouse = false;
    init.inp_rep_group_init.reports = input_reports;
    init.inp_rep_group_init.cnt = ARRAY_SIZE(input_reports);
    init.outp_feat_rep_group_init.reports = output_reports;
    init.outp_feat_rep_group_init.cnt = ARRAY_SIZE(output_reports);

    return bt_hids_init(&hids, &init);
}

void ble_hid_connected(struct bt_conn *conn)
{
    current_conn = bt_conn_ref(conn);
}

void ble_hid_disconnected(void)
{
    if (current_conn) {
        bt_conn_unref(current_conn);
        current_conn = NULL;
    }
}

static int send_keyboard_report(uint8_t modifier, uint8_t keycode)
{
    uint8_t report[8] = {
        modifier,
        0x00,
        keycode,
        0x00,
        0x00,
        0x00,
        0x00,
        0x00,
    };

    if (!current_conn) {
        return -ENOTCONN;
    }

    return bt_hids_inp_rep_send(&hids, current_conn,
                                INPUT_REPORT_ID_KEYBOARD,
                                report, sizeof(report), NULL);
}

int ble_hid_send_key_click(uint8_t keycode)
{
    int err;

    err = send_keyboard_report(0x00, keycode);
    if (err) {
        return err;
    }

    k_msleep(15);

    return send_keyboard_report(0x00, 0x00);
}

int ble_hid_send_key_state(uint8_t keycode, bool pressed)
{
    return send_keyboard_report(0x00, pressed ? keycode : 0x00);
}
```

## src/ble_hid.h
```c
#ifndef BLE_HID_H_
#define BLE_HID_H_

#include <stdint.h>
#include <stdbool.h>
#include <zephyr/bluetooth/conn.h>

#define BLE_HID_KEY_A_USAGE 0x04

int ble_hid_init(void);
void ble_hid_connected(struct bt_conn *conn);
void ble_hid_disconnected(void);
int ble_hid_send_key_state(uint8_t keycode, bool pressed);
int ble_hid_send_key_click(uint8_t keycode);

#endif
```

## src/factory_reset.c
```c
#include "factory_reset.h"

#include <errno.h>
#include <zephyr/bluetooth/bluetooth.h>
#include <zephyr/bluetooth/conn.h>
#include <zephyr/device.h>
#include <zephyr/devicetree.h>
#include <zephyr/drivers/gpio.h>
#include <zephyr/kernel.h>
#include <zephyr/logging/log.h>
#include <zephyr/sys/reboot.h>

LOG_MODULE_REGISTER(factory_reset, LOG_LEVEL_INF);

#define FACTORY_RESET_HOLD_MS 8000
#define FACTORY_RESET_POLL_MS 50

#if DT_NODE_HAS_STATUS(DT_ALIAS(sw0), okay)
static const struct gpio_dt_spec reset_button =
    GPIO_DT_SPEC_GET(DT_ALIAS(sw0), gpios);
#endif

int factory_reset_check_boot_request(void)
{
#if DT_NODE_HAS_STATUS(DT_ALIAS(sw0), okay)
    int err;
    int held_ms = 0;

    if (!gpio_is_ready_dt(&reset_button)) {
        LOG_WRN("Factory-reset GPIO is not ready");
        return -ENODEV;
    }

    err = gpio_pin_configure_dt(&reset_button, GPIO_INPUT);
    if (err) {
        LOG_WRN("Factory-reset GPIO configure failed: %d", err);
        return err;
    }

    while (gpio_pin_get_dt(&reset_button) > 0) {
        if (held_ms >= FACTORY_RESET_HOLD_MS) {
            LOG_WRN("Factory reset requested; clearing BLE bonds");
            err = bt_unpair(BT_ID_DEFAULT, NULL);
            if (err) {
                LOG_ERR("Bond clear failed: %d", err);
                return err;
            }

            k_sleep(K_MSEC(250));
            sys_reboot(SYS_REBOOT_COLD);
        }

        k_sleep(K_MSEC(FACTORY_RESET_POLL_MS));
        held_ms += FACTORY_RESET_POLL_MS;
    }

    return 0;
#else
    LOG_INF("No sw0 alias; factory reset button disabled");
    return 0;
#endif
}
```

## src/factory_reset.h
```c
#ifndef FACTORY_RESET_H_
#define FACTORY_RESET_H_

int factory_reset_check_boot_request(void);

#endif
```

## src/input_scanner.c
```c
#include "input_scanner.h"

#include <errno.h>
#include <zephyr/device.h>
#include <zephyr/devicetree.h>
#include <zephyr/drivers/gpio.h>
#include <zephyr/kernel.h>
#include <zephyr/logging/log.h>
#include <zephyr/sys/util.h>

LOG_MODULE_REGISTER(input_scanner, LOG_LEVEL_INF);

#define DEBOUNCE_MS 20

struct input_button {
    const struct gpio_dt_spec spec;
    struct gpio_callback callback;
    struct k_work_delayable debounce_work;
    uint8_t hid_keycode;
    bool stable_pressed;
    bool configured;
};

static input_scanner_event_handler_t event_handler;

#define BUTTON_COUNT                                                   \
    (DT_NODE_HAS_STATUS(DT_ALIAS(sw0), okay) +                         \
     DT_NODE_HAS_STATUS(DT_ALIAS(sw1), okay) +                         \
     DT_NODE_HAS_STATUS(DT_ALIAS(sw2), okay) +                         \
     DT_NODE_HAS_STATUS(DT_ALIAS(sw3), okay))

#define BUTTON_FROM_ALIAS(alias_name, keycode)                          \
    COND_CODE_1(DT_NODE_HAS_STATUS(DT_ALIAS(alias_name), okay),          \
        ({                                                              \
            .spec = GPIO_DT_SPEC_GET(DT_ALIAS(alias_name), gpios),       \
            .hid_keycode = keycode,                                     \
        },),                                                            \
        ())

#if BUTTON_COUNT > 0
static struct input_button buttons[] = {
    BUTTON_FROM_ALIAS(sw0, 0x04)
    BUTTON_FROM_ALIAS(sw1, 0x05)
    BUTTON_FROM_ALIAS(sw2, 0x06)
    BUTTON_FROM_ALIAS(sw3, 0x07)
};
#endif

static bool button_is_pressed(const struct input_button *button)
{
#if BUTTON_COUNT > 0
    int value = gpio_pin_get_dt(&button->spec);

    if (value < 0) {
        LOG_WRN("GPIO read failed: %d", value);
        return button->stable_pressed;
    }

    return value > 0;
#else
    ARG_UNUSED(button);
    return false;
#endif
}

static void debounce_work_handler(struct k_work *work)
{
    struct k_work_delayable *delayable = k_work_delayable_from_work(work);
    struct input_button *button = CONTAINER_OF(delayable,
                                               struct input_button,
                                               debounce_work);
    bool pressed = button_is_pressed(button);

    if (pressed == button->stable_pressed) {
        return;
    }

    button->stable_pressed = pressed;

    if (event_handler) {
        event_handler(button->hid_keycode, pressed);
    }
}

static void gpio_callback_handler(const struct device *dev,
                                  struct gpio_callback *cb,
                                  uint32_t pins)
{
    struct input_button *button = CONTAINER_OF(cb, struct input_button, callback);

    ARG_UNUSED(dev);
    ARG_UNUSED(pins);

    k_work_reschedule(&button->debounce_work, K_MSEC(DEBOUNCE_MS));
}

int input_scanner_init(input_scanner_event_handler_t handler)
{
    int err;

    event_handler = handler;

#if BUTTON_COUNT == 0
    LOG_WRN("No sw0-sw3 devicetree aliases found; input scanner idle");
    return 0;
#else
    if (ARRAY_SIZE(buttons) == 0) {
        LOG_WRN("No sw0-sw3 devicetree aliases found; input scanner idle");
        return 0;
    }

    for (size_t i = 0; i < ARRAY_SIZE(buttons); i++) {
        struct input_button *button = &buttons[i];

        if (!gpio_is_ready_dt(&button->spec)) {
            LOG_ERR("GPIO device is not ready");
            return -ENODEV;
        }

        err = gpio_pin_configure_dt(&button->spec, GPIO_INPUT);
        if (err) {
            LOG_ERR("GPIO configure failed: %d", err);
            return err;
        }

        button->stable_pressed = button_is_pressed(button);
        k_work_init_delayable(&button->debounce_work, debounce_work_handler);

        gpio_init_callback(&button->callback, gpio_callback_handler,
                           BIT(button->spec.pin));

        err = gpio_add_callback(button->spec.port, &button->callback);
        if (err) {
            LOG_ERR("GPIO callback add failed: %d", err);
            return err;
        }

        err = gpio_pin_interrupt_configure_dt(&button->spec,
                                              GPIO_INT_EDGE_BOTH);
        if (err) {
            LOG_ERR("GPIO interrupt configure failed: %d", err);
            return err;
        }

        button->configured = true;
    }

    LOG_INF("Input scanner ready with %u button(s)",
            (unsigned int)ARRAY_SIZE(buttons));
    return 0;
#endif
}
```

## src/input_scanner.h
```c
#ifndef INPUT_SCANNER_H_
#define INPUT_SCANNER_H_

#include <stdbool.h>
#include <stdint.h>

typedef void (*input_scanner_event_handler_t)(uint8_t hid_keycode, bool pressed);

int input_scanner_init(input_scanner_event_handler_t handler);

#endif
```

## src/power.c
```c
#include "power.h"

#include <zephyr/kernel.h>
#include <zephyr/logging/log.h>
#include <zephyr/pm/pm.h>

LOG_MODULE_REGISTER(power, LOG_LEVEL_INF);

void power_init(void)
{
    LOG_INF("Power policy initialized");
}

void power_on_connected(void)
{
    LOG_INF("Connected power profile active");
}

void power_on_disconnected(void)
{
    LOG_INF("Advertising power profile active");
}

void power_maintenance_run(void)
{
    /*
     * Put board-specific work here: quiesce unused sensors, lower scan rates,
     * sample battery less often while idle, and gate external regulators.
     */
}
```

## src/power.h
```c
#ifndef POWER_H_
#define POWER_H_

void power_init(void);
void power_on_connected(void);
void power_on_disconnected(void);
void power_maintenance_run(void);

#endif
```
